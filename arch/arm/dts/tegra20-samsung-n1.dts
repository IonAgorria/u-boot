// SPDX-License-Identifier: GPL-2.0
/dts-v1/;

#include <dt-bindings/input/input.h>

#include "tegra20-samsung-n1-common.dtsi"

/ {
	model = "Samsung Galaxy R (GT-I9103)";
	compatible = "samsung,n1", "nvidia,tegra20";

	gpio-keys {
		compatible = "gpio-keys";

		key-home {
			label = "Home";
			gpios = <&gpio TEGRA_GPIO(O, 5) GPIO_ACTIVE_LOW>;
			linux,code = <KEY_ENTER>;
		};
	};

#if 0
	host1x@50000000 {
		dc@54200000 {
			rgb {
				status = "okay";

				nvidia,panel = <&cmc623>;
			};
		};
	};

	cmc623: bridge {
		compatible = "samsung,cmc623";

		pwren-gpios = <&gpio TEGRA_GPIO(Q, 4) GPIO_ACTIVE_HIGH>;
		nrst-gpios = <&gpio TEGRA_GPIO(J, 6) GPIO_ACTIVE_HIGH>;
		bypass-gpios = <&gpio TEGRA_GPIO(BB, 5) GPIO_ACTIVE_HIGH>;
		sleep-gpios = <&gpio TEGRA_GPIO(W, 0) GPIO_ACTIVE_HIGH>;

		ldo1-supply = <&vdd_ima1>;
		ldo2-supply = <&vdd_ima2>;

		panel = <&panel>;
	};
	
	panel: panel {
		compatible = "simple-panel";

		power-supply = <&vdd_pnl_reg>;
		enable-gpios = <&gpio>;

		display-timings {
			timing@0 {
				/* 480x800 LCD panel */
				clock-frequency = <24000000>;
//				de-active = <1>;
//				pixelclk-active = <0>;
						
				hactive = <480>;
				hfront-porch = <10>;
				hback-porch = <20>;
				hsync-len = <10>;
//				hsync-active = <0>;
						
				vactive = <800>;
				vfront-porch = <3>;
				vback-porch = <4>;
				vsync-len = <2>;
//				vsync-active = <0>;
			};
		};
	};

//	GPIO_LCD_LDO_LED_EN TEGRA_GPIO_PR3
	vdd_pnl_reg: regulator-pnl {
		compatible = "regulator-fixed";
		regulator-name = "vdd_panel";
		regulator-min-microvolt = <3300000>; // fix
		regulator-max-microvolt = <3300000>; // fix
		gpio = <&gpio TEGRA_GPIO(R, 3) GPIO_ACTIVE_HIGH>;
		enable-active-high;
	};

//	GPIO_IMA_LDOEN1 TEGRA_GPIO_PL5
	vdd_ima1: regulator-ima1 {
		compatible = "regulator-fixed";
		regulator-name = "vdd_panel";
		regulator-min-microvolt = <3300000>; // fix
		regulator-max-microvolt = <3300000>; // fix
		gpio = <&gpio TEGRA_GPIO(L, 5) GPIO_ACTIVE_HIGH>;
		enable-active-high;
	};

//	GPIO_IMA_LDOEN2 TEGRA_GPIO_PX0
	vdd_ima2: regulator-ima2 {
		compatible = "regulator-fixed";
		regulator-name = "vdd_panel";
		regulator-min-microvolt = <3300000>; // fix
		regulator-max-microvolt = <3300000>; // fix
		gpio = <&gpio TEGRA_GPIO(X, 0) GPIO_ACTIVE_HIGH>;
		enable-active-high;
	};

// N1 may use non default polarities!
static struct tegra_dc_out_pin n1_dc_out_pins[] = {
	{
		.name	= TEGRA_DC_OUT_PIN_DATA_ENABLE,
		.pol	= TEGRA_DC_OUT_PIN_POL_HIGH,
	},
	{
		.name	= TEGRA_DC_OUT_PIN_H_SYNC,
		.pol	= TEGRA_DC_OUT_PIN_POL_LOW,
	},
	{
		.name	= TEGRA_DC_OUT_PIN_V_SYNC,
		.pol	= TEGRA_DC_OUT_PIN_POL_LOW,
	},
	{
		.name	= TEGRA_DC_OUT_PIN_PIXEL_CLOCK,
		.pol	= TEGRA_DC_OUT_PIN_POL_LOW,
	},
};
#endif
};
