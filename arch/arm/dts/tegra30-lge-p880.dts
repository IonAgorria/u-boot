// SPDX-License-Identifier: GPL-2.0-or-later
/dts-v1/;

#include "tegra30-lge-x3.dtsi"

/ {
	model = "LG Optimus 4X HD";
	compatible = "lge,p880", "nvidia,tegra30";

	aliases {
		mmc1 = &sdmmc3; /* uSD slot */
	};

	sdmmc3: sdhci@78000400  {
		status = "okay";
		bus-width = <4>;

		cd-gpios = <&gpio TEGRA_GPIO(W, 5) GPIO_ACTIVE_LOW>;

		vmmc-supply = <&vdd_usd>;
		vqmmc-supply = <&vdd_1v8_vio>;
	};
};
