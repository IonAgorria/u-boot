## board/motorola/olympus/Kconfig
```kconfig
if TARGET_OLYMPUS

config SYS_BOARD
	default "olympus"

config SYS_VENDOR
	default "motorola"

config SYS_CONFIG_NAME
	default "olympus"

endif
```

## board/samsung/n1/Kconfig
```kconfig
if TARGET_SAMSUNG_N1

config SYS_BOARD
	default "n1"

config SYS_VENDOR
	default "samsung"

config SYS_CONFIG_NAME
	default "n1"

endif
```

## drivers/crypto/tegra/Kconfig
```kconfig
config TEGRA_AES
	bool "Support the Tegra AES"
	select AES
	help
	  This provides a means to encrypt and decrypt data using the Tegra
	  Bit Stream Engine for Video/Audio. Also may provide a mean to
	  encrypt/decrypt/sign using already loaded device SBK.
```

## drivers/video/tegra20/Kconfig
```kconfig
config VIDEO_TEGRA20
	bool "Enable Display Controller support on Tegra20 and Tegra 30"
	depends on OF_CONTROL
	help
	   T20/T30 support video output to an attached LCD panel as well as
	   other options such as HDMI. Only the LCD is supported in U-Boot.
	   This option enables this support which can be used on devices which
	   have an LCD display connected.

config VIDEO_DSI_TEGRA30
	bool "Enable Tegra 30 DSI support"
	depends on PANEL && DM_GPIO
	select VIDEO_TEGRA20
	select VIDEO_MIPI_DSI
	help
	   T30 has native support for DSI panels. This option enables support
	   for such panels which can be used on endeavoru and tf600t.

config TEGRA_BACKLIGHT_PWM
	bool "Enable Tegra DC PWM backlight support"
	depends on BACKLIGHT
	select VIDEO_TEGRA20
	help
	   Tegra DC dependent backlight.

config TEGRA_8BIT_CPU_BRIDGE
	bool "Enable 8 bit panel communication protocol for Tegra 20/30"
	depends on PANEL && DM_GPIO
	select VIDEO_TEGRA20
	select VIDEO_MIPI_DSI
	help
	   Tegra 20 and Tegra 30 feature 8 bit CPU driver panel control
	   protocol. This option allows use it as a MIPI DSI bridge to
	   set up and control compatible panel.
```
