## board/hardkernel/odroid_go2/Kconfig
```kconfig
if TARGET_ODROID_GO2 || TARGET_ANBERNIC_RG351 || TARGET_GAMECONSOLE_R36S

config SYS_BOARD
	default "odroid_go2"

config SYS_VENDOR
	default "hardkernel"

config SYS_CONFIG_NAME
	default "odroid_go2"

endif
```
